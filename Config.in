## Config.in
```kconfig
source "$BR2_EXTERNAL_MG_PATH/package/fluidsynth/Config.in"
source "$BR2_EXTERNAL_MG_PATH/package/libmgurdy/Config.in"
source "$BR2_EXTERNAL_MG_PATH/package/python-mgurdy/Config.in"
source "$BR2_EXTERNAL_MG_PATH/package/python-peewee/Config.in"
source "$BR2_EXTERNAL_MG_PATH/package/python-sf2utils/Config.in"
source "$BR2_EXTERNAL_MG_PATH/package/python-marshmallow/Config.in"
source "$BR2_EXTERNAL_MG_PATH/package/python-flask-restful/Config.in"
source "$BR2_EXTERNAL_MG_PATH/package/python-prctl/Config.in"
source "$BR2_EXTERNAL_MG_PATH/package/python-pyalsa/Config.in"
source "$BR2_EXTERNAL_MG_PATH/package/mgdocs/Config.in"
source "$BR2_EXTERNAL_MG_PATH/package/mgweb/Config.in"
source "$BR2_EXTERNAL_MG_PATH/package/ladspa/Config.in"
source "$BR2_EXTERNAL_MG_PATH/package/mgeffects/Config.in"
source "$BR2_EXTERNAL_MG_PATH/package/libwebsockets-mg/Config.in"
```

## configs/a20_olimex_som_mgurdy_defconfig
```kconfig
BR2_GLOBAL_PATCH_DIR="$(BR2_EXTERNAL)/board/patches"
BR2_arm=y
BR2_cortex_a7=y
BR2_ARM_FPU_NEON_VFPV4=y
BR2_SVN="svn"
BR2_KERNEL_MIRROR="https://www.kernel.org/pub"
BR2_GNU_MIRROR="http://ftp.gnu.org/pub/gnu"
BR2_JLEVEL=4
BR2_CCACHE=y
BR2_OPTIMIZE_3=y
BR2_PACKAGE_OVERRIDE_FILE="$(BR2_EXTERNAL)/local.mk"
BR2_TOOLCHAIN_EXTERNAL=y
BR2_TARGET_GENERIC_HOSTNAME="midigurdy"
BR2_TARGET_GENERIC_ISSUE="Welcome to the MidiGurdy!"
BR2_ROOTFS_DEVICE_CREATION_DYNAMIC_MDEV=y
BR2_SYSTEM_BIN_SH_BASH=y
BR2_TARGET_GENERIC_GETTY_PORT="ttyS0"
# BR2_TARGET_GENERIC_REMOUNT_ROOTFS_RW is not set
BR2_ENABLE_LOCALE_WHITELIST="C en_GB"
BR2_GENERATE_LOCALE="en_GB"
BR2_ROOTFS_OVERLAY="$(BR2_EXTERNAL)/rootfs"
BR2_ROOTFS_POST_BUILD_SCRIPT="$(BR2_EXTERNAL)/board/bin/post-build.sh"
BR2_ROOTFS_POST_SCRIPT_ARGS="$(BR2_EXTERNAL)"
BR2_LINUX_KERNEL=y
BR2_LINUX_KERNEL_CUSTOM_TARBALL=y
BR2_LINUX_KERNEL_CUSTOM_TARBALL_LOCATION="https://github.com/midigurdy/linux/archive/mg-4.14-rt/mg-4.14-rt.tar.gz"
BR2_LINUX_KERNEL_USE_CUSTOM_CONFIG=y
BR2_LINUX_KERNEL_CUSTOM_CONFIG_FILE="$(BR2_EXTERNAL)/board/linux.config"
BR2_LINUX_KERNEL_DTS_SUPPORT=y
BR2_LINUX_KERNEL_CUSTOM_DTS_PATH="$(BR2_EXTERNAL_MG_PATH)/board/linux/sun7i-a20-olimex-som-mgurdy.dts"
BR2_LINUX_KERNEL_INSTALL_TARGET=y
BR2_PACKAGE_BUSYBOX_CONFIG="$(BR2_EXTERNAL)/board/busybox.config"
BR2_PACKAGE_BUSYBOX_SHOW_OTHERS=y
BR2_PACKAGE_ALSA_UTILS=y
BR2_PACKAGE_ALSA_UTILS_ALSACONF=y
BR2_PACKAGE_ALSA_UTILS_ACONNECT=y
BR2_PACKAGE_ALSA_UTILS_AMIDI=y
BR2_PACKAGE_ALSA_UTILS_AMIXER=y
BR2_PACKAGE_ALSA_UTILS_APLAY=y
BR2_PACKAGE_ALSA_UTILS_APLAYMIDI=y
BR2_PACKAGE_ALSA_UTILS_SPEAKER_TEST=y
BR2_PACKAGE_GZIP=y
BR2_PACKAGE_EVTEST=y
BR2_PACKAGE_POWERTOP=y
BR2_PACKAGE_UBOOT_TOOLS=y
BR2_PACKAGE_UBOOT_TOOLS_MKENVIMAGE=y
BR2_PACKAGE_LIBARCHIVE=y
BR2_PACKAGE_LIBARCHIVE_BSDTAR=y
BR2_PACKAGE_LIBARCHIVE_BSDCPIO=y
BR2_PACKAGE_AVAHI=y
BR2_PACKAGE_AVAHI_DAEMON=y
BR2_PACKAGE_OPENSSH=y
BR2_PACKAGE_RSYNC=y
BR2_PACKAGE_FILE=y
BR2_PACKAGE_HTOP=y
BR2_PACKAGE_SWUPDATE=y
BR2_PACKAGE_SWUPDATE_CONFIG="$(BR2_EXTERNAL)/board/swupdate.config"
# BR2_PACKAGE_SWUPDATE_INSTALL_WEBSITE is not set
BR2_PACKAGE_UTIL_LINUX_SCHEDUTILS=y
BR2_TARGET_ROOTFS_EXT2=y
BR2_TARGET_ROOTFS_EXT2_4=y
BR2_TARGET_ROOTFS_EXT2_LABEL="MGSYS"
BR2_TARGET_ROOTFS_EXT2_SIZE="180M"
BR2_TARGET_ROOTFS_EXT2_RESBLKS=0
BR2_TARGET_ROOTFS_EXT2_MKFS_OPTIONS="-O ^64bit,^has_journal -E stride=2,stripe-width=2048 -b 4096"
BR2_TARGET_UBOOT=y
BR2_TARGET_UBOOT_BUILD_SYSTEM_KCONFIG=y
BR2_TARGET_UBOOT_CUSTOM_VERSION=y
BR2_TARGET_UBOOT_CUSTOM_VERSION_VALUE="2016.09.01"
BR2_TARGET_UBOOT_USE_CUSTOM_CONFIG=y
BR2_TARGET_UBOOT_CUSTOM_CONFIG_FILE="$(BR2_EXTERNAL)/board/uboot.config"
BR2_TARGET_UBOOT_NEEDS_DTC=y
BR2_TARGET_UBOOT_SPL=y
BR2_TARGET_UBOOT_SPL_NAME="u-boot-sunxi-with-spl.bin"
BR2_TARGET_UBOOT_ENVIMAGE=y
BR2_TARGET_UBOOT_ENVIMAGE_SOURCE="$(BR2_EXTERNAL)/board/uboot/uboot.env"
BR2_TARGET_UBOOT_ENVIMAGE_SIZE="0x20000"
BR2_TARGET_UBOOT_CUSTOM_DTS_PATH="$(BR2_EXTERNAL_MG_PATH)/board/uboot/sun7i-a20-olimex-som-mgurdy.dts"
BR2_PACKAGE_HOST_GENEXT2FS=y
BR2_PACKAGE_HOST_UBOOT_TOOLS=y
BR2_PACKAGE_LIBMGURDY=y
BR2_PACKAGE_PYTHON_MGURDY=y
BR2_PACKAGE_PYTHON_PRCTL=y
BR2_PACKAGE_MGWEB=y
BR2_PACKAGE_LADSPA=y
BR2_PACKAGE_MGEFFECTS=y
BR2_PACKAGE_LIBWEBSOCKETS_MG=y
```

## package/libmgurdy/Config.in
```kconfig
config BR2_PACKAGE_LIBMGURDY
	bool "libmgurdy"
	help
      Provides a shared library containing the core MidiGurdy functions that
      are performance critical and therefor implemented in C instead of Python.
```

## package/libwebsockets-mg/Config.in
```kconfig
config BR2_PACKAGE_LIBWEBSOCKETS_MG
	bool "libwebsockets-mg"
	depends on BR2_USE_MMU # fork()
	select BR2_PACKAGE_ZLIB
	help
	  Libwebsockets is a lightweight pure C library built to use
	  minimal CPU and memory resources, and provide fast throughput
	  in both directions. This package is a copy of the original package for the MidiGurdy, without IPv6 support
      
	  http://libwebsockets.org/
```

## package/mg-fluidsynth/Config.in
```kconfig
config BR2_PACKAGE_MG_FLUIDSYNTH
	bool "mg-fluidsynth"
	select BR2_PACKAGE_LIBGLIB2
	depends on BR2_USE_WCHAR # libglib2
	depends on BR2_TOOLCHAIN_HAS_THREADS # libglib2
	depends on BR2_USE_MMU # libglib2
	help
	  FluidSynth is a real-time software synthesizer based on the
	  SoundFont 2 specifications
```

## package/mgdocs/Config.in
```kconfig
config BR2_PACKAGE_MGDOCS
	bool "mgdocs"
	help
      Provides the MidiGurdy online documentation
```

## package/mgeffects/Config.in
```kconfig
config BR2_PACKAGE_MGEFFECTS
	bool "mgeffects"
	help
      Provides LADSPA effects for the MidiGurdy
```

## package/mgweb/Config.in
```kconfig
config BR2_PACKAGE_MGWEB
	bool "mgweb"
	help
      Provides the MidiGurdy web interface
```

## package/python-flask-restful/Config.in
```kconfig
config BR2_PACKAGE_PYTHON_FLASK_RESTFUL
	bool "python-flask-restful"
	# runtime dependency
	select BR2_PACKAGE_PYTHON_FLASK
	help
	  Flask-RESTful adds support for quickly building REST APIs
```

## package/python-mgurdy/Config.in
```kconfig
config BR2_PACKAGE_PYTHON_MGURDY
	bool "python-mgurdy"
    select BR2_PACKAGE_PYTHON_CFFI
    select BR2_PACKAGE_PYTHON3
    select BR2_PACKAGE_FREETYPE
    select BR2_PACKAGE_FLUIDSYNTH
    select BR2_PACKAGE_PYTHON_MARSHMALLOW
    select BR2_PACKAGE_PYTHON_SF2UTILS
    select BR2_PACKAGE_PYTHON_ALSAAUDIO
    select BR2_PACKAGE_PYTHON3_SQLITE
    select BR2_PACKAGE_PYTHON_FLASK_RESTFUL
    select BR2_PACKAGE_PYTHON_PEEWEE
    select BR2_PACKAGE_PYTHON_WEBSOCKETS
    select BR2_PACKAGE_PYTHON_PYALSA
    select BR2_PACKAGE_PYTHON_PILLOW
	help
	  The main MidiGurdy program
```

## package/python-prctl/Config.in
```kconfig
config BR2_PACKAGE_PYTHON_PRCTL
	bool "python-prctl"
    select BR2_PACKAGE_LIBCAP
	help
	  Python(ic) interface to the linux prctl syscall.

	  http://github.com/seveas/python-prctl
```

## package/python-pyalsa/Config.in
```kconfig
config BR2_PACKAGE_PYTHON_PYALSA
	bool "python-pyalsa"
	help
	  Native Python alsa bindings
```

## package/python-sf2utils/Config.in
```kconfig
config BR2_PACKAGE_PYTHON_SF2UTILS
	bool "python-sf2utils"
	help
	  soundfont utilities
```
